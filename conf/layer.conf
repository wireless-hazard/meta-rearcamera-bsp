## conf/layer.conf
```bitbake
# We have a conf and classes directory, add to BBPATH
BBPATH .= ":${LAYERDIR}"

# We have recipes-* directories, add to BBFILES
BBFILES += "${LAYERDIR}/recipes-*/*/*.bb \
            ${LAYERDIR}/recipes-*/*/*.bbappend"

BBFILE_COLLECTIONS += "meta-rearcamera"
BBFILE_PATTERN_meta-rearcamera = "^${LAYERDIR}/"
BBFILE_PRIORITY_meta-rearcamera = "10"

LAYERDEPENDS_meta-rearcamera = "core"
LAYERSERIES_COMPAT_meta-rearcamera = "kirkstone scarthgap"

MACHINE = "raspberrypi0-wifi"

# Enables I2C
ENABLE_I2C = "1"

# Enables the Video Camera
VIDEO_CAMERA = "1"

#Furthermore, to auto-load I2C kernel modules set:

IMAGE_FSTYPES += "wic wic.bmap"

KERNEL_MODULE_AUTOLOAD:rpi += "i2c-dev cfg80211 brcmfmac brcmutil bluetooth brcmfmac-wcc v4l2-async videobuf2_v4l2 videodev videobuf2_common mc uvc \ 
uvcvideo usb-f-uvc i2c-mux-pinctrl"

IMAGE_INSTALL:append = " i2cdev i2c-tools \
c-periphery mpu-read openssh linux-firmware-bcm43430 \
iw wpa-supplicant wireless-regdb-static kernel-module-brcmfmac broadcom-bt-firmware kernel-module-i2c-mux-pinctrl \
kernel-module-brcmutil kernel-module-cfg80211 kernel-module-bluetooth kernel-module-brcmfmac-wcc kernel-module-i2c-mux-pinctrl kernel-module-ov5647 kernel-module-videodev kernel-module-v4l2-fwnode \
v4l-utils kernel-module-v4l2-async kernel-module-videobuf2-v4l2 kernel-module-videodev kernel-module-videobuf2-common kernel-module-mc kernel-module-uvc \ 
kernel-module-uvcvideo kernel-module-usb-f-uvc openh264 gstreamer1.0 gstreamer1.0-plugins-base gstreamer1.0-plugins-good gstreamer1.0-plugins-bad webcam-stream \ 
tf-luna opencv libcamera dtc libgpiod libgpiod-dev libgpiod-tools ov5647-regulator" 

# Kernel modules used in the video camera stack
IMAGE_INSTALL:append = " kernel-module-videobuf2-dma-contig kernel-module-bcm2835-mmal-vchiq kernel-module-v4l2-mem2mem kernel-module-bcm2835-codec kernel-module-v4l2-async \
 kernel-module-v4l2-dv-timings kernel-module-bcm2835-unicam kernel-module-vc-sm-cma kernel-module-bcm2835-isp kernel-module-videobuf2-vmalloc kernel-module-bcm2835-v4l2"

KERNEL_MODULE_AUTOLOAD:rpi += ""

LICENSE_FLAGS_ACCEPTED += "commercial"

RPI_KERNEL_DEVICETREE_OVERLAYS:remove = "overlays/disable-wifi.dtbo overlays/disable-bt.dtbo"

RPI_KERNEL_DEVICETREE_OVERLAYS:append = " overlays/i2c-sensor.dtbo overlays/ssd1306.dtbo overlays/ov5647.dtbo overlays/i2c0.dtbo overlays/i2c-mux.dtbo overlays/i2c-gpio.dtbo"
RPI_EXTRA_CONFIG = 'dtoverlay=i2c-sensor,mpu6050\ndtoverlay=ssd1306,inverted\ncamera_auto_detect=1\ndisplay_auto_detect=1\n'

# Chooses the default console for the device. Use fbcon=map:0 to use the ssd1306 OLED
# CMDLINE:append = " fbcon=map:1"
```
