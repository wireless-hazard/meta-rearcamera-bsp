// Definitions for MPU6050
/dts-v1/;
/plugin/;

/ {
        compatible = "brcm,bcm2708";

        fragment@0 {
                target = <&i2c1>;
                __overlay__ {
                        #address-cells = <1>;
                        #size-cells = <0>;
                        status = "okay";
                        clock-frequency = <400000>;

                        mpu6050: mpu6050@68 {
                                compatible = "invensense,mpu6050";
                                reg = <0x68>;
                                interrupt-parent = <&gpio>;
                                interrupts = <4 1>;
                                VDDIO-supply = <&reg_3p3v>;
                                mount-matrix = "-0.984807753012208",  /* x0 */
                                                "0",                   /* y0 */
                                                "-0.173648177666930",  /* z0 */
                                                "0",                   /* x1 */
                                                "-1",                  /* y1 */
                                                "0",                   /* z1 */
                                                "-0.173648177666930",  /* x2 */
                                                "0",                   /* y2 */
                                                "0.984807753012208";   /* z2 */
                        };
                };
        };

        __overrides__ {
                interrupt = <&mpu6050>,"interrupts:0";
        };
};